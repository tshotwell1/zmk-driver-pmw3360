## dts/bindings/input/pixart,pmw3360.yaml
```yaml
# Copyright (c) 2025 The ZMK Contributors
# SPDX-License-Identifier: MIT
description: |
  Sensor driver for the pixart PMW3389 optical mouse sensor

compatible: "pixart,pmw3360"

include: spi-device.yaml

properties:
  irq-gpios:
    type: phandle-array
    description: "The GPIO which has the motion pin wired to it. If not specified, the device will be polled instead."
  reset-gpios:
    type: phandle-array
    description: "The GPIO which is wired to the reset pin, not used if not specifed."
  cpi:
    type: int
    default: 600
    description: "CPI value (Range: 50 - 16000, in steps of 50)"
  rotation:
    type: int
    default: 0
    description: |
      Compensate for the sensor being mounted at an angle, by rotating the
      reported motion by this many degrees (Range: 0 - 359). Whole degrees
      only. The rotation is applied in software, before invert-x / invert-y.
      If the movement comes out mirrored across the axis you expected, use
      360 minus your angle instead.
  rotate-90:
    type: boolean
    description: "Deprecated, use 'rotation = <90>' instead."
  rotate-180:
    type: boolean
    description: "Deprecated, use 'rotation = <180>' instead."
  rotate-270:
    type: boolean
    description: "Deprecated, use 'rotation = <270>' instead."
  angle-tune:
    type: int
    default: 0 
    description: |
      Adjust the sensor angle in degrees (Range: -30 - 30). This is applied by
      the sensor itself, so it costs nothing at runtime, but it cannot express
      angles beyond +/-30 degrees. Prefer 'rotation' unless you have a reason
      not to.
  lift-height-3mm:
    type: boolean
    description: "Configure the lift-off height to be 3mm rather than the default 2mm."
  polling-interval:
    type: int
    default: 1000 
    description: "The time, in microseconds, to wait between sensor polls when operating without an irq configured."
  invert-x:
    type: boolean
    description:
      "If true, invert the X axis."
  invert-y:
    type: boolean
    description:
      "If true, invert the Y axis."
```
